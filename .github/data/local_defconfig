## .github/data/local_defconfig
```kconfig
CONFIG_MODULES=y
CONFIG_SMP=y
CONFIG_PCI=y
CONFIG_PCI_IOV=y
CONFIG_PCI_MSI=y
CONFIG_NET=y
CONFIG_NETDEVICES=y
CONFIG_NET_SWITCHDEV=y
CONFIG_NET_CORE=y
CONFIG_INET=y
CONFIG_VXLAN=y
CONFIG_ZLIB_INFLATE=y
CONFIG_NFP=m
CONFIG_ISO9660_FS=y
CONFIG_ZISOFS=y
CONFIG_SPARSE_RCU_POINTER=y
CONFIG_BPF_SYSCALL=y
CONFIG_TLS=y
CONFIG_TLS_DEVICE=y
CONFIG_BNXT=y
CONFIG_ETHERNET=y
CONFIG_NET_VENDOR_BROADCOM=y
CONFIG_INET_ESP=y
CONFIG_INET_ESP_OFFLOAD=y
CONFIG_INET6_ESP=y
CONFIG_INET6_ESP_OFFLOAD=y
CONFIG_CGROUPS=y
CONFIG_INFINIBAND=m
CONFIG_INFINIBAND_USER_MAD=m
CONFIG_INFINIBAND_USER_ACCESS=m
CONFIG_INFINIBAND_USER_MEM=y
CONFIG_INFINIBAND_ON_DEMAND_PAGING=y
CONFIG_INFINIBAND_ADDR_TRANS=y
CONFIG_INFINIBAND_ADDR_TRANS_CONFIGFS=y
CONFIG_INFINIBAND_VIRT_DMA=y
CONFIG_SECURITY_INFINIBAND=y
```
